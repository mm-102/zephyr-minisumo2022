## Kconfig
```kconfig
menu "Custom Board Drivers"

config SUMO_6_MOTOR_DRIVER
    bool "H-Bridge Motor Driver"
    default y
    depends on PWM && GPIO
    help
      Enables the custom motor driver for sumo_6.

endmenu
```

## boards/sims/sumo_6/Kconfig.defconfig
```kconfig
if BOARD_SUMO_6

config BOARD
	default "sumo_6"

if WIFI
config WIFI_ESP32
    default y
endif

endif # BOARD_SUMO_6
```

## boards/sims/sumo_6/board.yml
```yaml
board:
  name: sumo_6
  full_name: Minisumo 2022 ESP32-S2
  vendor: sims
  socs:
    - name: esp32s2
```

## boards/sims/sumo_6/sumo_6_defconfig
```kconfig
CONFIG_CONSOLE=y
CONFIG_SERIAL=y
CONFIG_UART_CONSOLE=y

CONFIG_GPIO=y
CONFIG_PWM=y
CONFIG_SUMO_6_MOTOR_DRIVER=y

CONFIG_SPI=y
CONFIG_LED_STRIP=y
```

## dts/bindings/sims,hbridge-motor.yaml
```yaml
description: Custom H-Bridge Motor Driver mapping 2 PWMs and 2 GPIOs

compatible: "vendor123,hbridge-motor"

include: [base.yaml]

properties:
  pwms:
    type: phandle-array
    required: true
    description: PWM pins for L1 and R1

  pwm-names:
    type: string-array
    required: true
    description: Names of the PWM pins (must be "l1", "r1")

  l2-gpios:
    type: phandle-array
    required: true
    description: GPIO pin for L2

  r2-gpios:
    type: phandle-array
    required: true
    description: GPIO pin for R2
```
